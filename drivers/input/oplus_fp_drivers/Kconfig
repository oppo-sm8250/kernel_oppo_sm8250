## drivers/input/oplus_fp_drivers/Kconfig
```kconfig
menuconfig OPLUS_FINGERPRINT
	bool "OPLUS fingerprint"
	depends on SPI_MASTER
	help
	  Say Y here to enable OPLUS fingerprint support

if OPLUS_FINGERPRINT
### platform config
config OPLUS_FINGERPRINT_QCOM
       default n
       tristate "Fingerprint base on QCOM"

### fingerprint sensor config
config OPLUS_FINGERPRINT_GOODIX_OPTICAL
       default n
       tristate "Fingerprint base on goodix optical chip"

endif #OPLUS_FINGERPRINT
```

## drivers/power/oplus/Kconfig
```kconfig
menuconfig OPLUS_CHARGER
	bool "OPLUS charging system"
	depends on I2C
	select REGMAP_I2C
	help
	  Say Y here to enable OPLUS charging system support

if OPLUS_CHARGER
#ifdef VENDOR_EDIT /* Jianchao.Shi@BSP.CHG.Basic, 2018/01/12, sjc Add for charging */
config OPLUS_SM8250_CHARGER
	tristate "OPLUS SM8150 charger driver"
	depends on MFD_SPMI_PMIC
	help
	  Enables support for the oplus charging framework

config OPLUS_CALL_MODE_SUPPORT
	bool "OPLUS call mode support"
	help
	  Say Y to include support

config OPLUS_SMART_CHARGER_SUPPORT
	bool "OPLUS smart charger support"
	help
	  Say Y to include support

config OPLUS_CHIP_SOC_NODE
	bool "OPLUS chip soc node"
	help
	  Say Y to include support

config OPLUS_SHORT_USERSPACE
	bool "OPLUS batt userspace"
	help
	 Say Y to include support

config OPLUS_RTC_DET_SUPPORT
	tristate "OPLUS RTC DET SUPPORT"
	default n
	depends on MFD_SPMI_PMIC
	help
	  Say Y to include support

config OPLUS_CHECK_CHARGERID_VOLT
	tristate "OPLUS CHECK CHARGERID VOLT"
	default n
	depends on MFD_SPMI_PMIC
	help
	  Say Y to include support

config OPLUS_SHIP_MODE_SUPPORT
	tristate "OPLUS_SHIP_MODE_SUPPORT"
	default n
	depends on MFD_SPMI_PMIC
	help
	  Say Y to include support
	  
config OPLUS_SHORT_C_BATT_CHECK
	bool "OPLUS batt short "
	help
	  Say Y here to declare OPLUS batt short	  

config OPLUS_STANDARD_BATTERY_CHECK_ADC
	bool "OPLUS Official Standard Battery check by ADC"
	help
	  Say Y here to support Official Standard Battery check by ADC

config OPLUS_SHORT_IC_CHECK
	bool "OPLUS short ic"
	help
	  Say Y here to declare OPLUS batt short

config OPLUS_SHORT_HW_CHECK
	bool "OPLUS batt HW SHORT "
	help
	  Say Y here to declare charging system is on MTK

config OPLUS_SHORT_USERSPACE
	bool "OPLUS batt userspace"
	help
	  Say Y to include support

config OPLUS_CHIP_SOC_NODE
	bool "OPLUS chip soc node"
	help
	  Say Y to include support
endif #OPLUS_CHARGER
```

## drivers/soc/oplus/system/Kconfig
```kconfig
config OPLUS_SYSTEM_KERNEL
  bool "config oplus system feature "
  default y
  help
	define this config to add oplus sytstem kernel feature

config OPLUS_ARCH_FILE
  bool "for build directory oplus"
  ---help---
  say Y to buid in

config OPLUS_COMMON_SOFT
  bool "config oplus common software"
  help
	define this config to get project verion from sharemem.
	Maybe this value is from CDT or dynamic identify by hardware
	id.
```
