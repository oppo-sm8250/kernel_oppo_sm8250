&kona_snd {
	qcom,auxpcm-audio-intf = <1>;
};

&qupv3_se15_i2c {
	max989xx@39 {
		compatible = "maxim,max98927L";
		reg = <0x39>;
		mono_stereo_mode = <3>;
		interleave_mode = <1>;
		range_mohms = <4800 7800>;
		maxim,98927-reset-gpio = <&tlmm 91 0x00>;
		max989xx_vdd-supply = <&pm8150_s4>;
		status = "okay";
	};

	max989xx@3a {
		compatible = "maxim,max98927R";
		reg = <0x3a>;
		mono_stereo_mode = <3>;
		interleave_mode = <1>;
		range_mohms = <5500 8500>;
		maxim,98927-reset-gpio = <&tlmm 99 0x00>;
		max989xx_vdd-supply = <&pm8150_s4>;
		status = "okay";
	};
};