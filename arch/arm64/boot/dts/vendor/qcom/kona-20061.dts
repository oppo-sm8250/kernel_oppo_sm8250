/dts-v1/;

#include "kona.dtsi"

/ {
	model = "Qualcomm Technologies, Inc. kona v1 SoC";
	compatible = "qcom,kona";
	qcom,board-id = <0 0>;
	oplus,dtsi_no = <20061>;
};

#include "oplus/kona.dtsi"
#include "oplus/20061/kona.dtsi"