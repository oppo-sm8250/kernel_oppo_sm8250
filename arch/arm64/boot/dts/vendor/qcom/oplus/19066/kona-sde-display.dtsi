#include "dsi-panel-oplus19065-samsung-1440-3168-dsc-cmd.dtsi"
#include "pxlw/pxlw-iris5.dtsi"
#include "pxlw/dsi-panel-pxlw.dtsi"

&mdss_mdp {
	connectors = <&sde_dp &sde_wb &sde_dsi &sde_rscc>;
};

&sde_dsi {
	qcom,dsi-default-panel = <&dsi_oplus19065_samsung_1440_3168_dsc_cmd>;
};

&msm_notifier {
	panel = <&dsi_oplus19065_samsung_1440_3168_dsc_cmd>;
};